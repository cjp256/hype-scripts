## build/conf/bblayers.conf
```bitbake
# LAYER_CONF_VERSION is increased each time build/conf/bblayers.conf
# changes incompatibly
LCONF_VERSION = "5"

BASEDIR = "${TOPDIR}/.."
BBPATH = "${TOPDIR}"

BBLAYERS ?= " \
  ${BASEDIR}/openembedded-core/meta \
  ${BASEDIR}/meta-openembedded/meta-oe \
  ${BASEDIR}/meta-openembedded/meta-networking \
  ${BASEDIR}/meta-intel \
  ${BASEDIR}/meta-intel/meta-sugarbay \
  ${BASEDIR}/meta-measured \
  ${BASEDIR}/meta-virtualization \
  ${BASEDIR}/meta-hype \
  ${BASEDIR}/meta-xengt \
  "

BBFILE_PRIORITY_openembedded-layer = "4"
PREFERRED_VERSION_xen = "4.3.0"
PREFERRED_VERSION_linux-yocto = "3.8.13+gitAUTOINC+f706bd410c_f20047520a"
```

## dom0-xengt/conf/bblayers.conf
```bitbake
# LAYER_CONF_VERSION is increased each time build/conf/bblayers.conf
# changes incompatibly
LCONF_VERSION = "5"

BASEDIR = "${TOPDIR}/.."
BBPATH = "${TOPDIR}"

BBLAYERS ?= " \
  ${BASEDIR}/openembedded-core/meta \
  ${BASEDIR}/meta-openembedded/meta-efl \
  ${BASEDIR}/meta-openembedded/meta-filesystems \
  ${BASEDIR}/meta-openembedded/meta-gnome \
  ${BASEDIR}/meta-openembedded/meta-gpe \
  ${BASEDIR}/meta-openembedded/meta-initramfs \
  ${BASEDIR}/meta-openembedded/meta-multimedia \
  ${BASEDIR}/meta-openembedded/meta-networking \
  ${BASEDIR}/meta-openembedded/meta-oe \
  ${BASEDIR}/meta-openembedded/meta-perl \
  ${BASEDIR}/meta-openembedded/meta-ruby \
  ${BASEDIR}/meta-openembedded/meta-systemd \
  ${BASEDIR}/meta-openembedded/meta-webserver \
  ${BASEDIR}/meta-openembedded/meta-xfce \
  ${BASEDIR}/meta-intel \
  ${BASEDIR}/meta-intel/meta-sugarbay \
  ${BASEDIR}/meta-measured \
  ${BASEDIR}/meta-virtualization \
  ${BASEDIR}/meta-xengt \
  ${BASEDIR}/meta-hype \
  ${BASEDIR}/meta-games \
  ${BASEDIR}/meta-yocto-bloat \
  "

BBFILE_PRIORITY_openembedded-layer = "4"

#PREFERRED_VERSION_xen = "4.4%"

PREFERRED_VERSION_linux-yocto = "3.8%"
```
